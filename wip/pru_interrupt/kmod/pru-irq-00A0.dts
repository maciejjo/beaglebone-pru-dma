/dts-v1/;
/plugin/;

/ {
	compatible = "ti,beaglebone", "ti,beaglebone-black", "ti,beaglebone-green";

	fragment@0 {
		target-path="/";
		__overlay__ {
			pru-irq {
				compatible = "pru-irq";
				interrupt-parent = <&pruss_intc>;
				interrupts = <22>;
				interrupt-names = "irq";
			};
		};
	};
};
